## boards/holyiot/holyiot_25008/Kconfig.holyiot_25008
```kconfig
config BOARD_HOLYIOT_25008
	select SOC_NRF54L15_CPUAPP if BOARD_HOLYIOT_25008_NRF54L15_CPUAPP
	select SOC_NRF54L15_CPUFLPR if \
		BOARD_HOLYIOT_25008_NRF54L15_CPUFLPR || \
		BOARD_HOLYIOT_25008_NRF54L15_CPUFLPR_XIP
```

## boards/holyiot/holyiot_25008/board.yml
```yaml
board:
  name: holyiot_25008
  vendor: holyiot
  socs:
  - name: nrf54l15
    variants:
    - name: xip
      cpucluster: cpuflpr
```

## boards/holyiot/holyiot_25015/board.yml
```yaml
board:
  name: holyiot_25015
  vendor: holyiot
  socs:
  - name: nrf54l15
    variants:
    - name: xip
      cpucluster: cpuflpr
```
