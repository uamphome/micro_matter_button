#include "holyiot_25015_nrf54l15_cpuflpr.dts"

/ {
	compatible = "holyiot,holyiot-25015-cpuflpr-xip";
};

&cpuflpr_sram {
	reg = <0x2002f000 DT_SIZE_K(68)>;
	ranges = <0x0 0x2002f000 DT_SIZE_K(68)>;
};
